## avsync-lib/Config.in
```kconfig
config BR2_PACKAGE_AV_SYNC_LIB
        bool "avsync-lib"
        help
          AV sync user library based on kernel tsync driver
          Unit test also provided.
```
